/{
	pcdev-1{
	org,size = <512>;
	org,device-serial-num = "PCDEV1ABC123";
	org,perm = <0X11>;
	};
	
  	pcdev-2{
        org,size = <1024>;
        org,device-serial-num = "PCDEV2ABC456";
        org,perm = <0X11>;
        };

	pcdev-1{
        org,size = <256>;
        org,device-serial-num = "PCDEV3ABC789";
        org,perm = <0X11>;
        };
  	
	pcdev-1{
        org,size = <2048>;
        org,device-serial-num = "PCDEV4ABC000";
        org,perm = <0X11>;
        };

};
